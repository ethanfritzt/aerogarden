## main/Kconfig.projbuild.example
```kconfig
menu "Aerogarden Config"

config WIFI_SSID
    string "SSID"
    default "ssid"
    help
        SSID of WIFI network

config WIFI_PASS
    string "WIFI Password"
    default "pass"
    help
        Password for WIFI network

config MQTT_BROKER_URI
    string "MQTT Broker URI"
    default "mqtt://"
    help
        URI of the MQTT broker.

config MQTT_USER
    string "MQTT Username"
    default "username"
    help
        Username

config MQTT_PASS
    string "MQTT Password"
    default "pass"
    help
        Password

endmenu
```
